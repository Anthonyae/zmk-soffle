/ {
    leds {
        compatible = "pwm-leds";
        backlight: led_0 {
            pwms = <&pwm0 0 PWM_MSEC(1) PWM_POLARITY_NORMAL>;
        };
    };

    chosen {
        zmk,backlight = &backlight;
    };
};